## esp32_capture/sdkconfig.defaults
```kconfig
# ESP32-C3 defaults for garage handshake capture rig
CONFIG_ESP_CONSOLE_USB_SERIAL_JTAG=y
CONFIG_FREERTOS_HZ=1000
```

## esp32_ccdebug/sdkconfig.defaults
```kconfig
# ESP32-C3 defaults for CC1110 debug dumper
CONFIG_ESP_CONSOLE_USB_SERIAL_JTAG=y
CONFIG_FREERTOS_HZ=1000
```
